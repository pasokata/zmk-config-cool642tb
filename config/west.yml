## config/west.yml
```yaml
manifest:
  remotes:
    - name: zmkfirmware
      url-base: https://github.com/zmkfirmware
    - name: telzo2000
      url-base: https://github.com/telzo2000
    - name: pasokata
      url-base: https://github.com/pasokata
  projects:
    - name: zmk
      remote: zmkfirmware
      revision: main
      import: app/west.yml
    - name: zmk-pmw3610-driver
      remote: telzo2000
      revision: main
    - name: zmk-behavior-swapper
      remote: pasokata
      revision: main      
  self:
    path: config
```
